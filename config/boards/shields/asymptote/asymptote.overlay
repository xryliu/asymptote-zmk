#include "slicemk_ergodox.dtsi"

&default_transform {
	col-offset = <1>;
};

/ {
kscan0: kscan {
		compatible = "zmk,kscan-gpio-matrix";
		label = "KSCAN";
		diode-direction = "row2col";
        
  		col-gpios
			= <&ergodox_a 2 (GPIO_ACTIVE_HIGH | GPIO_PULL_DOWN)>
			, <&ergodox_a 3 (GPIO_ACTIVE_HIGH | GPIO_PULL_DOWN)>
			, <&ergodox_a 15 (GPIO_ACTIVE_HIGH | GPIO_PULL_DOWN)>
			, <&ergodox_a 28 (GPIO_ACTIVE_HIGH | GPIO_PULL_DOWN)>
			, <&ergodox_a 10 (GPIO_ACTIVE_HIGH | GPIO_PULL_DOWN)>
			, <&ergodox_a 5 (GPIO_ACTIVE_HIGH | GPIO_PULL_DOWN)>
			
			;
		row-gpios
			= <&ergodox_a  14 GPIO_ACTIVE_HIGH>
			, <&ergodox_a  29 GPIO_ACTIVE_HIGH>
			, <&ergodox_a  13 GPIO_ACTIVE_HIGH>
			, <&ergodox_a 11 GPIO_ACTIVE_HIGH>
			, <&ergodox_a 12 GPIO_ACTIVE_HIGH>
			, <&ergodox_a 4 GPIO_ACTIVE_HIGH>
			;
	};
};      
        
        
        
        
       
