## config/boards/shields/asymptote/Kconfig.defconfig
```kconfig
# Copyright (c) 2020 The ZMK Contributors
# SPDX-License-Identifier: MIT

if SHIELD_ASYMPTOTE
config ZMK_BLE
	default y

config ZMK_USB
	default y
	
config ZMK_KEYBOARD_NAME
    default "SliceMK ErgoDox"


endif
```
